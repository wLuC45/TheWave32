## firmware/ble-airtag-finder/sdkconfig.defaults
```kconfig
# --- TheWave32 / ble-airtag-finder ----------------------------------------------------
CONFIG_IDF_TARGET="esp32s3"
CONFIG_ESP_DEFAULT_CPU_FREQ_MHZ_240=y
CONFIG_FREERTOS_HZ=1000
CONFIG_ESP_CONSOLE_NONE=y
CONFIG_LOG_DEFAULT_LEVEL_ERROR=y
CONFIG_BT_ENABLED=y
CONFIG_BT_NIMBLE_ENABLED=y
CONFIG_BT_BLUEDROID_ENABLED=n
CONFIG_BT_CONTROLLER_ENABLED=y
CONFIG_BT_NIMBLE_NVS_PERSIST=n
CONFIG_BT_NIMBLE_MAX_CONNECTIONS=1
CONFIG_BT_NIMBLE_HOST_TASK_STACK_SIZE=4096
CONFIG_SPIRAM=y
CONFIG_SPIRAM_MODE_OCT=y
CONFIG_SPIRAM_SPEED_80M=y
CONFIG_SPIRAM_USE_MALLOC=y
CONFIG_BOOTLOADER_LOG_LEVEL_WARN=y
CONFIG_PARTITION_TABLE_CUSTOM=y
CONFIG_PARTITION_TABLE_CUSTOM_FILENAME="partitions.csv"
CONFIG_PARTITION_TABLE_FILENAME="partitions.csv"
CONFIG_COMPILER_OPTIMIZATION_PERF=y
```

## firmware/ble-scanner/sdkconfig.defaults
```kconfig
# --- TheWave32 / ble-scanner --------------------------------------------------
# ESP32-S3 + NimBLE-only stack for minimum RAM. UART0 owned by app.

CONFIG_IDF_TARGET="esp32s3"

CONFIG_ESP_DEFAULT_CPU_FREQ_MHZ_240=y
CONFIG_FREERTOS_HZ=1000

# IDF console silenced; UART0 belongs to tw32_io.
CONFIG_ESP_CONSOLE_NONE=y
CONFIG_LOG_DEFAULT_LEVEL_ERROR=y

# Bluetooth: NimBLE host on the controller.
CONFIG_BT_ENABLED=y
CONFIG_BT_NIMBLE_ENABLED=y
CONFIG_BT_BLUEDROID_ENABLED=n
CONFIG_BT_CONTROLLER_ENABLED=y

# NimBLE: keep all roles enabled (NimBLE source has cross-role symbol
# refs not properly guarded; disabling roles breaks the build). The
# scanner only USES observer.
CONFIG_BT_NIMBLE_NVS_PERSIST=n
CONFIG_BT_NIMBLE_MAX_CONNECTIONS=1
CONFIG_BT_NIMBLE_HOST_TASK_STACK_SIZE=4096

# PSRAM available but not required by the scanner.
CONFIG_SPIRAM=y
CONFIG_SPIRAM_MODE_OCT=y
CONFIG_SPIRAM_SPEED_80M=y
CONFIG_SPIRAM_USE_MALLOC=y

# Faster bootloader.
CONFIG_BOOTLOADER_LOG_LEVEL_WARN=y

# Custom partition table.
CONFIG_PARTITION_TABLE_CUSTOM=y
CONFIG_PARTITION_TABLE_CUSTOM_FILENAME="partitions.csv"
CONFIG_PARTITION_TABLE_FILENAME="partitions.csv"

CONFIG_COMPILER_OPTIMIZATION_PERF=y
```

## firmware/spectrum-analyzer/sdkconfig.defaults
```kconfig
# --- TheWave32 / spectrum-analyzer --------------------------------------------
# 2.4 GHz Wi-Fi RSSI heatmap, channel-hopping in promiscuous mode.

CONFIG_IDF_TARGET="esp32s3"

CONFIG_ESP_DEFAULT_CPU_FREQ_MHZ_240=y
CONFIG_FREERTOS_HZ=1000

CONFIG_ESP_CONSOLE_NONE=y
CONFIG_LOG_DEFAULT_LEVEL_ERROR=y

# We never accept Wi-Fi connections; tighten buffer counts.
CONFIG_ESP_WIFI_STATIC_RX_BUFFER_NUM=4
CONFIG_ESP_WIFI_DYNAMIC_RX_BUFFER_NUM=8
CONFIG_ESP_WIFI_DYNAMIC_TX_BUFFER_NUM=8
CONFIG_ESP_WIFI_AMPDU_TX_ENABLED=n
CONFIG_ESP_WIFI_AMPDU_RX_ENABLED=n

CONFIG_SPIRAM=y
CONFIG_SPIRAM_MODE_OCT=y
CONFIG_SPIRAM_SPEED_80M=y
CONFIG_SPIRAM_USE_MALLOC=y

CONFIG_BOOTLOADER_LOG_LEVEL_WARN=y

CONFIG_PARTITION_TABLE_CUSTOM=y
CONFIG_PARTITION_TABLE_CUSTOM_FILENAME="partitions.csv"
CONFIG_PARTITION_TABLE_FILENAME="partitions.csv"

CONFIG_COMPILER_OPTIMIZATION_PERF=y
```

## firmware/usb-hid-keyboard/sdkconfig.defaults
```kconfig
# --- TheWave32 / usb-hid-keyboard --------------------------------------------
# Uses the ESP32-S3's USB-OTG controller as a USB HID keyboard.
# Plug the dev board's native-USB connector into a target PC; it
# enumerates as a HID keyboard. Our own management CLI keeps using
# UART0 via the CH343 bridge — separate USB connector.

CONFIG_IDF_TARGET="esp32s3"

CONFIG_ESP_DEFAULT_CPU_FREQ_MHZ_240=y
CONFIG_FREERTOS_HZ=1000

# UART0 console for the JSON-Lines CLI (CH343 bridge).
CONFIG_ESP_CONSOLE_NONE=y
CONFIG_LOG_DEFAULT_LEVEL_ERROR=y

# We need exclusive use of the USB peripheral for TinyUSB HID — so
# disable the USB-Serial-JTAG console (which would otherwise grab it).
CONFIG_ESP_CONSOLE_USB_SERIAL_JTAG=n

# TinyUSB: enable HID class with 1 instance.
CONFIG_TINYUSB=y
CONFIG_TINYUSB_HID_ENABLED=y
CONFIG_TINYUSB_HID_COUNT=1

# PSRAM (8 MB octal); not strictly required for HID, but consistent.
CONFIG_SPIRAM=y
CONFIG_SPIRAM_MODE_OCT=y
CONFIG_SPIRAM_SPEED_80M=y
CONFIG_SPIRAM_USE_MALLOC=y

CONFIG_BOOTLOADER_LOG_LEVEL_WARN=y

CONFIG_PARTITION_TABLE_CUSTOM=y
CONFIG_PARTITION_TABLE_CUSTOM_FILENAME="partitions.csv"
CONFIG_PARTITION_TABLE_FILENAME="partitions.csv"

CONFIG_COMPILER_OPTIMIZATION_PERF=y
```

## firmware/wifi-deauth/sdkconfig.defaults
```kconfig
# Target chip
CONFIG_IDF_TARGET="esp32s3"

# CPU + RTOS
CONFIG_ESP_DEFAULT_CPU_FREQ_MHZ_240=y
CONFIG_FREERTOS_HZ=1000

# Route IDF console to UART0 too so panic dumps appear alongside our JSON.
# Log level kept at WARN — no normal-path noise, but warnings/errors visible.
CONFIG_ESP_CONSOLE_UART_DEFAULT=y
CONFIG_LOG_DEFAULT_LEVEL_WARN=y

# PSRAM (8 MB octal)
CONFIG_SPIRAM=y
CONFIG_SPIRAM_MODE_OCT=y
CONFIG_SPIRAM_SPEED_80M=y
CONFIG_SPIRAM_USE_MALLOC=y
# Without this, Wi-Fi internal buffers are forced into the small internal-RAM
# heap and `esp_wifi_scan_start` can stall the chip silently (see hardware.md).
CONFIG_SPIRAM_TRY_ALLOCATE_WIFI_LWIP=y

# Bootloader quiet
CONFIG_BOOTLOADER_LOG_LEVEL_WARN=y

# Use custom partition table
CONFIG_PARTITION_TABLE_CUSTOM=y
CONFIG_PARTITION_TABLE_CUSTOM_FILENAME="partitions.csv"
CONFIG_PARTITION_TABLE_FILENAME="partitions.csv"

# Optimisation
CONFIG_COMPILER_OPTIMIZATION_PERF=y
```

## firmware/wifi-evil-twin-detector/sdkconfig.defaults
```kconfig
# --- TheWave32 / wifi-evil-twin-detector ----------------------------------------------------
CONFIG_IDF_TARGET="esp32s3"
CONFIG_ESP_DEFAULT_CPU_FREQ_MHZ_240=y
CONFIG_FREERTOS_HZ=1000
CONFIG_ESP_CONSOLE_NONE=y
CONFIG_LOG_DEFAULT_LEVEL_ERROR=y
CONFIG_SPIRAM=y
CONFIG_SPIRAM_MODE_OCT=y
CONFIG_SPIRAM_SPEED_80M=y
CONFIG_SPIRAM_USE_MALLOC=y
CONFIG_SPIRAM_TRY_ALLOCATE_WIFI_LWIP=y
CONFIG_ESP_WIFI_STATIC_RX_BUFFER_NUM=10
CONFIG_ESP_WIFI_DYNAMIC_RX_BUFFER_NUM=32
CONFIG_ESP_WIFI_DYNAMIC_TX_BUFFER_NUM=32
CONFIG_ESP_WIFI_AMPDU_RX_ENABLED=y
CONFIG_BOOTLOADER_LOG_LEVEL_WARN=y
CONFIG_PARTITION_TABLE_CUSTOM=y
CONFIG_PARTITION_TABLE_CUSTOM_FILENAME="partitions.csv"
CONFIG_PARTITION_TABLE_FILENAME="partitions.csv"
CONFIG_COMPILER_OPTIMIZATION_PERF=y
```

## firmware/wifi-ghost/sdkconfig.defaults
```kconfig
# --- TheWave32 / wifi-ghost ----------------------------------------------------
# Target ESP32-S3, UART0 owned by app (CH343 bridge), 240 MHz, PSRAM enabled.

CONFIG_IDF_TARGET="esp32s3"

CONFIG_ESP_DEFAULT_CPU_FREQ_MHZ_240=y
CONFIG_FREERTOS_HZ=1000

CONFIG_ESP_CONSOLE_NONE=y
CONFIG_LOG_DEFAULT_LEVEL_ERROR=y

# PSRAM (8 MB octal). Wi-Fi/lwIP buffers go to PSRAM to avoid stalls.
CONFIG_SPIRAM=y
CONFIG_SPIRAM_MODE_OCT=y
CONFIG_SPIRAM_SPEED_80M=y
CONFIG_SPIRAM_USE_MALLOC=y
CONFIG_SPIRAM_TRY_ALLOCATE_WIFI_LWIP=y

CONFIG_ESP_WIFI_STATIC_RX_BUFFER_NUM=10
CONFIG_ESP_WIFI_DYNAMIC_RX_BUFFER_NUM=32
CONFIG_ESP_WIFI_DYNAMIC_TX_BUFFER_NUM=32
CONFIG_ESP_WIFI_AMPDU_RX_ENABLED=y

CONFIG_BOOTLOADER_LOG_LEVEL_WARN=y

CONFIG_PARTITION_TABLE_CUSTOM=y
CONFIG_PARTITION_TABLE_CUSTOM_FILENAME="partitions.csv"
CONFIG_PARTITION_TABLE_FILENAME="partitions.csv"

CONFIG_COMPILER_OPTIMIZATION_PERF=y
```

## firmware/wifi-scanner/sdkconfig.defaults
```kconfig
# --- TheWave32 / wifi-scanner -------------------------------------------------
# Target ESP32-S3 with UART0 owned by the application (CH343 bridge),
# 240 MHz CPU, PSRAM enabled.

CONFIG_IDF_TARGET="esp32s3"

# CPU + RTOS
CONFIG_ESP_DEFAULT_CPU_FREQ_MHZ_240=y
CONFIG_FREERTOS_HZ=1000

# IDF console: disable so we own UART0 for our JSON line protocol.
# Bootloader still prints to UART0 directly via ROM (early boot only),
# which is fine — host drains it before sending its first command.
CONFIG_ESP_CONSOLE_NONE=y

# ESP_LOG: keep error level so panics still print, but no INFO noise
# in the JSON stream.
CONFIG_LOG_DEFAULT_LEVEL_ERROR=y

# PSRAM (8 MB on the v0rtex board)
CONFIG_SPIRAM=y
CONFIG_SPIRAM_MODE_OCT=y
CONFIG_SPIRAM_SPEED_80M=y
CONFIG_SPIRAM_USE_MALLOC=y
CONFIG_SPIRAM_TRY_ALLOCATE_WIFI_LWIP=y

# Wi-Fi: scanner doesn't need lwIP buffers tuned high.
CONFIG_ESP_WIFI_STATIC_RX_BUFFER_NUM=8
CONFIG_ESP_WIFI_DYNAMIC_RX_BUFFER_NUM=16
CONFIG_ESP_WIFI_DYNAMIC_TX_BUFFER_NUM=16

# Faster bootloader.
CONFIG_BOOTLOADER_LOG_LEVEL_WARN=y

# Custom partition table.
CONFIG_PARTITION_TABLE_CUSTOM=y
CONFIG_PARTITION_TABLE_CUSTOM_FILENAME="partitions.csv"
CONFIG_PARTITION_TABLE_FILENAME="partitions.csv"

# Compiler.
CONFIG_COMPILER_OPTIMIZATION_PERF=y
```
